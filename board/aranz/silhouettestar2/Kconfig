## board/aranz/silhouettestar2/Kconfig
```kconfig
if TARGET_SILHOUETTESTAR2

config SYS_BOARD
	default "silhouettestar2"

config SYS_VENDOR
	default "aranz"

config SYS_CONFIG_NAME
	default "silhouettestar2"

config SYS_TEXT_BASE
    default 0x17800000
	
endif
```

## configs/silhouettestar2_defconfig
```kconfig
CONFIG_ARM=y
CONFIG_ARCH_MX6=y
CONFIG_SYS_EXTRA_OPTIONS="IMX_CONFIG=arch/arm/mach-imx/spl_sd.cfg"
CONFIG_TARGET_SILHOUETTESTAR2=y
CONFIG_BOOTDELAY=10
CONFIG_DISTRO_DEFAULTS=y
CONFIG_NR_DRAM_BANKS=1
CONFIG_BOOTCOMMAND="run boot_aranz"
CONFIG_BOARD_EARLY_INIT_F=y
CONFIG_OF_CONTROL=y
CONFIG_OF_LIBFDT=y
CONFIG_FSL_ESDHC=y
CONFIG_PHYLIB=y
CONFIG_MII=y
CONFIG_BOUNCE_BUFFER=y

CONFIG_DEFAULT_DEVICE_TREE="imx6dl-silhouettestar2"

CONFIG_SPL=y
CONFIG_SPL_FRAMEWORK_BOARD_INIT_F=y
CONFIG_SPL_SERIAL_SUPPORT=y
CONFIG_SPL_LIBCOMMON_SUPPORT=y
CONFIG_SPL_BANNER_PRINT=y
# CONFIG_SPL_EXT_SUPPORT=y
# CONFIG_SPL_I2C_SUPPORT=y
# CONFIG_SPL_FS_EXT4=y
CONFIG_SPL_MMC_SUPPORT=y
CONFIG_SPL_LIBDISK_SUPPORT=y
CONFIG_SPL_WATCHDOG_SUPPORT=y
CONFIG_SPL_GPIO_SUPPORT=y
CONFIG_SPL_LIBGENERIC_SUPPORT=y
CONFIG_SPL_GPIO=y

CONFIG_CMD_GPIO=y
CONFIG_CMD_MMC=y
CONFIG_CMD_PART=y
CONFIG_CMD_CACHE=y
CONFIG_CMD_EXT2=y
CONFIG_CMD_EXT4=y
CONFIG_CMD_FAT=y
CONFIG_CMD_EXT4_WRITE=y
CONFIG_CMD_FS_GENERIC=y

CONFIG_ENV_IS_IN_MMC=y
CONFIG_ENV_VARS_UBOOT_RUNTIME_CONFIG=y
CONFIG_ENV_SIZE=0x2000
CONFIG_ENV_OFFSET=0xFE000

CONFIG_DM=y
CONFIG_DM_MMC=y
CONFIG_DM_GPIO=y
CONFIG_DM_THERMAL=y
CONFIG_DM_REGULATOR=y
CONFIG_DM_REGULATOR_FIXED=y
CONFIG_DM_ETH=y

CONFIG_PINCTRL=y
CONFIG_PINCTRL_IMX6=y
```
